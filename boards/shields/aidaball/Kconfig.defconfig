## boards/shields/aidaball/Kconfig.defconfig
```kconfig
if SHIELD_AIDABALL

config ZMK_KEYBOARD_NAME
    default "AIDABALL"

config ZMK_BLE
    default y

config NFCT_PINS_AS_GPIOS
    default n

config INPUT
    default y

config ZMK_POINTING
    default y

config SPI
    default y

config PMW3610
    default y

config PMW3610_SWAP_XY
    default y

config RGBLED_WIDGET_BATTERY_LEVEL_HIGH
    default 30

config RGBLED_WIDGET_BATTERY_LEVEL_CRITICAL
    default 10

endif
```

## config/west.yml
```yaml
manifest:
  remotes:
    - name: zmkfirmware
      url-base: https://github.com/zmkfirmware
    - name: powerenterkey
      url-base: https://github.com/PowerEnterKey
    - name: caksoylar  # RGB LED
      url-base: https://github.com/caksoylar  
    - name: badjeff    # PMW3610
      url-base: https://github.com/badjeff
  projects:
    - name: zmk
      remote: zmkfirmware
      revision: v0.3
      import: app/west.yml
    - name: zmk-rgbled-widget
      remote: caksoylar
      revision: 8756cb7
    - name: zmk-pmw3610-driver
      remote: badjeff
      revision: zmk-0.3
  self:
    path: config
```
